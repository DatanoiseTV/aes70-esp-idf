## components/aes70/Kconfig
```kconfig
menu "AES70 (OCA) device"

    config AES70_MAX_OBJECTS
        int "Maximum number of OCA objects (incl. managers and blocks)"
        range 8 1024
        default 128
        help
            Upper bound on the device's object tree. Each slot is one pointer in
            the registry; the objects themselves are allocated on creation.

    config AES70_MAX_CONNECTIONS
        int "Maximum concurrent controller connections (TCP)"
        range 1 16
        default 4
        help
            Each OCP.1 controller opens one TCP connection. Each connection owns
            a receive assembly buffer of AES70_RX_BUFFER_SIZE bytes.

    config AES70_RX_BUFFER_SIZE
        int "Per-connection receive/assembly buffer (bytes)"
        range 512 16384
        default 2048
        help
            Largest OCP.1 message the device will assemble. Commands larger than
            this are rejected with a NAK-equivalent (the connection is closed).

    config AES70_TX_BUFFER_SIZE
        int "Shared transmit scratch buffer (bytes)"
        range 512 16384
        default 2048
        help
            Largest OCP.1 response or notification the device will emit.

    config AES70_MAX_SUBSCRIPTIONS
        int "Maximum active event subscriptions across all controllers"
        range 4 1024
        default 64
        help
            One slot per (controller, emitter, property) subscription created via
            OcaSubscriptionManager.AddSubscription.

    config AES70_KEEPALIVE_TIMEOUT_FACTOR
        int "Drop a connection after this many missed keep-alive intervals"
        range 2 10
        default 3
        help
            A controller negotiates a heartbeat interval in its first KeepAlive.
            If no KeepAlive arrives within factor * interval, the device closes
            the connection and removes its subscriptions.

    config AES70_TASK_STACK_SIZE
        int "OCP.1 server task stack size (bytes)"
        range 3072 16384
        default 6144

    config AES70_TASK_PRIORITY
        int "OCP.1 server task priority"
        range 1 24
        default 5

    config AES70_ENABLE_TLS
        bool "Enable secure OCP.1 (OCP.1 over TLS)"
        default n
        help
            Compile in a TLS listener for secure OCP.1, advertised as
            _ocasec._tcp. Pass the server certificate/key (and optionally a
            client CA for mutual authentication) through aes70_device_config_t.
            A mutually-authenticated controller becomes "privileged" and may
            write objects marked secured with aes70_object_set_secured().
            Pulls in the esp-tls / mbedTLS stack; leave off if you do not need
            transport security.

    config AES70_TLS_HANDSHAKE_TIMEOUT_MS
        int "TLS handshake timeout (ms)"
        depends on AES70_ENABLE_TLS
        range 1000 60000
        default 8000
        help
            A connection whose TLS handshake does not complete within this
            window is dropped, so a client that stalls mid-handshake cannot
            tie up a connection slot.

endmenu
```

## examples/p4_nano_dsp/main/Kconfig.projbuild
```kconfig
menu "AES70 DSP Demo Configuration"

    config AES70_DEMO_DEVICE_NAME
        string "Device name (shown to controllers and in mDNS)"
        default "AES70 DSP Demo"

    config AES70_DEMO_MANUFACTURER
        string "Manufacturer name"
        default "Example Audio"

    config AES70_DEMO_MODEL
        string "Model name"
        default "DSP-1"

    config AES70_DEMO_SERIAL
        string "Serial number"
        default "SN-0001"

    config AES70_DEMO_PORT
        int "OCP.1 TCP port"
        range 1024 65535
        default 65000

endmenu
```

## examples/p4_nano_dsp/sdkconfig.defaults
```kconfig
# Default connection: wired Ethernet (the ESP32-P4-Nano has an on-board PHY).
# The per-target pin map / PHY model lives in sdkconfig.defaults.<target>
# (see sdkconfig.defaults.esp32p4). To use Wi-Fi instead, flip these and set the
# SSID/password under "Example Connection Configuration" in `idf.py menuconfig`.
CONFIG_EXAMPLE_CONNECT_ETHERNET=y
CONFIG_EXAMPLE_CONNECT_WIFI=n

# mDNS responder.
CONFIG_MDNS_MAX_INTERFACES=3

# A little extra main-task stack headroom for the network bring-up.
CONFIG_ESP_MAIN_TASK_STACK_SIZE=5120
```

## examples/p4_nano_dsp/sdkconfig.defaults.esp32p4
```kconfig
# ESP32-P4-Nano: connect via the on-board Ethernet (IP101 PHY, internal EMAC,
# RMII). No companion C6 / Wi-Fi needed.
#
# example_connect() delegates Ethernet to the espressif/ethernet_init component,
# which reads CONFIG_ETHERNET_* and assigns every RMII pin from Kconfig. The pin
# map below is the ESP32-P4-Nano RMII wiring (matches the ESP32-P4 EVB):
#   MDC=31  MDIO=52  PHY_RST=51  REF_CLK=50 (external 50 MHz, input)
#   TX_EN=49  TXD0=34  TXD1=35  CRS_DV=28  RXD0=29  RXD1=30   PHY addr=1
# NOTE: do NOT use the 23/18/5 values from some IP101 sample configs -- those are
# the classic-ESP32 defaults and are wrong for the ESP32-P4.
CONFIG_EXAMPLE_CONNECT_ETHERNET=y
CONFIG_EXAMPLE_CONNECT_WIFI=n

CONFIG_ETHERNET_INTERNAL_SUPPORT=y
CONFIG_ETHERNET_PHY_IP101=y
CONFIG_ETHERNET_PHY_ADDR=1
CONFIG_ETHERNET_PHY_RST_GPIO=51
CONFIG_ETHERNET_MDC_GPIO=31
CONFIG_ETHERNET_MDIO_GPIO=52
CONFIG_ETHERNET_PHY_INTERFACE_RMII=y
CONFIG_ETHERNET_RMII_CLK_INPUT=y
CONFIG_ETHERNET_RMII_CLK_GPIO=50
CONFIG_ETHERNET_RMII_TX_EN_GPIO=49
CONFIG_ETHERNET_RMII_TXD0_GPIO=34
CONFIG_ETHERNET_RMII_TXD1_GPIO=35
CONFIG_ETHERNET_RMII_CRS_DV_GPIO=28
CONFIG_ETHERNET_RMII_RXD0_GPIO=29
CONFIG_ETHERNET_RMII_RXD1_GPIO=30

# Early ESP32-P4 silicon (e.g. rev v1.3): IDF v6.0 defaults the minimum chip
# revision to v3.01 and refuses to boot on v1.x. Select the "<3.0" revision
# family and set the minimum to v1.0. Remove these two on v3.x production silicon.
CONFIG_ESP32P4_SELECTS_REV_LESS_V3=y
CONFIG_ESP32P4_REV_MIN_100=y
```
